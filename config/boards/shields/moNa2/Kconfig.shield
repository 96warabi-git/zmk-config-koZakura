## config/boards/shields/moNa2/Kconfig.shield
```kconfig
config SHIELD_KOZAKURA48_R
    def_bool $(shields_list_contains,koZakura48_R)

config SHIELD_KOZAKURA48_L
    def_bool $(shields_list_contains,koZakura48_L)
```

## config/west.yml
```yaml
manifest:
  remotes:
    - name: zmkfirmware
      url-base: https://github.com/zmkfirmware
    - name: sayu-hub
      url-base: https://github.com/sayu-hub
    - name: badjeff
      url-base: https://github.com/badjeff
    - name: caksoylar
      url-base: https://github.com/caksoylar

  projects:
    - name: zmk
      remote: zmkfirmware
      revision: v0.2.1
      import: app/west.yml

    #- name: zmk-pmw3610-driver
    #  remote: sayu-hub
    #  revision: zmk-0.3

    # badjeff版を使う場合（必要なら）
    - name: zmk-pmw3610-driver
      remote: badjeff
      revision: zmk-0.3

    - name: zmk-rgbled-widget
      remote: caksoylar
      revision: main

  self:
    path: config
```
